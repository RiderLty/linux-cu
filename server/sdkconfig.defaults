## server/sdkconfig.defaults
```kconfig
# USB HID Passthrough - sdkconfig defaults
CONFIG_TINYUSB_CDC_ENABLED=y
CONFIG_TINYUSB_CDC_COUNT=1
CONFIG_TINYUSB_HID_COUNT=4
CONFIG_TINYUSB_MODE_DMA=y
CONFIG_TINYUSB_SUSPEND_CALLBACK=y
CONFIG_TINYUSB_RESUME_CALLBACK=y
```
